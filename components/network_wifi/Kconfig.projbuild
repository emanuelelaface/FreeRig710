## components/network_wifi/Kconfig.projbuild
```kconfig
if ESP_WIFI_REMOTE_ENABLED
    if $(ESP_IDF_VERSION) >= "6.0.1" && $(ESP_IDF_VERSION) < "6.1"
        orsource "../../managed_components/espressif__esp_wifi_remote/Kconfig.idf_v6.0.in"
    endif
endif
```
